## Hardware/CAREM1/electret/Kconfig/Kconfig.shield
```kconfig
osource "c:/users/lyled/dmic/boards/shields/*/Kconfig.shield"
osource "c:/users/lyled/uart/boards/shields/*/Kconfig.shield"
osource "c:/users/lyled/ble_mic/boards/shields/*/Kconfig.shield"
osource "c:/users/lyled/blinky/boards/shields/*/Kconfig.shield"
osource "c:/users/lyled/electret/boards/shields/*/Kconfig.shield"
osource "c:/users/lyled/carem1/boards/shields/*/Kconfig.shield"
osource "C:/ncs/v2.9.0/nrf/boards/shields/*/Kconfig.shield"
```

## Hardware/CAREM1/electret/Kconfig/Kconfig.shield.defconfig
```kconfig
osource "c:/users/lyled/dmic/boards/shields/*/Kconfig.defconfig"
osource "c:/users/lyled/uart/boards/shields/*/Kconfig.defconfig"
osource "c:/users/lyled/ble_mic/boards/shields/*/Kconfig.defconfig"
osource "c:/users/lyled/blinky/boards/shields/*/Kconfig.defconfig"
osource "c:/users/lyled/electret/boards/shields/*/Kconfig.defconfig"
osource "c:/users/lyled/carem1/boards/shields/*/Kconfig.defconfig"
osource "C:/ncs/v2.9.0/nrf/boards/shields/*/Kconfig.defconfig"
```

## Hardware/CAREM1/electret/Kconfig/boards/Kconfig.defconfig
```kconfig
# Load Zephyr board defconfig descriptions.
osource "C:/ncs/v2.9.0/zephyr/boards/seeed/xiao_ble/Kconfig.defconfig"
```

## Hardware/CAREM1/electret/Kconfig/boards/Kconfig.sysbuild
```kconfig
# Load Sysbuild board Kconfig descriptions.
osource "C:/ncs/v2.9.0/zephyr/boards/seeed/xiao_ble/Kconfig.sysbuild"
```

## Hardware/CAREM1/no_IMU/Kconfig/boards/Kconfig
```kconfig
# Load Zephyr board Kconfig descriptions.
osource "C:/ncs/v2.9.0/zephyr/boards/seeed/xiao_ble/Kconfig"
```
